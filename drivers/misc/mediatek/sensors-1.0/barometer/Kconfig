## drivers/misc/mediatek/sensors-1.0/barometer/Kconfig
```kconfig
config CUSTOM_KERNEL_BAROMETER
	bool "CUSTOM KERNEL BAROMETER Config"
	help
	  To detect barometer raw data
```

## drivers/misc/mediatek/sensors-1.0/humidity/Kconfig
```kconfig
config CUSTOM_KERNEL_HUMIDITY
	bool "CUSTOM KERNEL HUMIDITY Config"
	help
	  To detect humidity raw data
```
